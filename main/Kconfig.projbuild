## main/Kconfig.projbuild
```kconfig
menu "Blackmagic Configuration"

    config ESP_WIFI_AP_SSID
        string "WiFi AP SSID"
        default "Farpatch"
        help
           SSID (network name) for ap and sta modes.
           auto - generates name automatically when in ap mode using mac address for ex. blackmagic_27FCF5E

    config ESP_WIFI_AP_SSID_APPEND_CHIPID
        bool "Append Chip ID to AP SSID"
        default y
        help
            If true, will append the chip ID to the SSID when running in AP mode
    
    config ESP_WIFI_AP_PASSWORD
        string "WiFi AP Password"
        default ""
        help
           WiFi password (WPA or WPA2) for AP mode

    config MAX_STA_CONN
        int "Max STA conn"
        default 4
        help
        Max number of the STA connects to AP.

    config TDI_GPIO
        int "TDI GPIO"
        default 13
        help
        TDI GPIO number
        
    config TDO_GPIO
        int "TDO GPIO"
        default 14
        help
        TDO GPIO number
        
    config TMS_SWDIO_GPIO
        int "SWDIO/TMS GPIO"
        default 0
        help
        TMS/SWDIO GPIO number
        
    config TCK_SWCLK_GPIO
        int "SWCLK/TCK GPIO"
        default 2
        help
        TCK/SWDIO GPIO number		
            
    config SRST_GPIO
        int "SRST GPIO"
        default 12
        help
        Reset GPIO Number

    config TARGET_UART
        bool "Target UART support"
        default y
        help
        Connect the UART to the target device
    
    config TARGET_UART_TX_GPIO
        int "UART TX pin"
            depends on TARGET_UART
        default 26
        help
        Pin to use for target UART TX

    config TARGET_UART_RX_GPIO
        int "UART RX pin"
            depends on TARGET_UART
        default 27
        help
        Pin to use for target UART RX
        
    config DEBUG_UART
        bool "Use debug UART for log messages"
        default y
        help
        Uses the ESP32 debug UART to monitor blackmagic messages.

    config BLACKMAGIC_HOSTNAME
        string "Hostname"
        default "blackmagic"
        help
        Hostname for the blackmagic probe.

endmenu
```
